/ {
	chosen {
		nordic,pm-ext-flash = &w25q32;
	};
};

/* Restore the RRAM and SRAM that are reserved for FLPR by default. */
&cpuapp_rram {
	reg = <0x0 DT_SIZE_K(1524)>;
};

&cpuapp_sram {
	reg = <0x20000000 DT_SIZE_K(256)>;
	ranges = <0x0 0x20000000 0x40000>;
};
