## boards/smart_switch_rev1/Kconfig.defconfig
```kconfig
# Copyright (c) 2024 Nordic Semiconductor ASA
# SPDX-License-Identifier: Apache-2.0

config HW_STACK_PROTECTION
	default ARCH_HAS_STACK_PROTECTION

if BOARD_SMART_SWITCH_REV1_CPUAPP

config ROM_START_OFFSET
	default 0 if PARTITION_MANAGER_ENABLED
	default 0x800 if BOOTLOADER_MCUBOOT

endif # BOARD_SMART_SWITCH_REV1_CPUAPP

if BOARD_SMART_SWITCH_REV1_NRF54L15_CPUAPP

config BT_CTLR
	bool
	default BT

endif # BOARD_SMART_SWITCH_REV1_NRF54L15_CPUAPP

if BOARD_SMART_SWITCH_REV1_CPUAPP_NS

config BOARD_SMART_SWITCH_REV1
	select USE_DT_CODE_PARTITION if BOARD_SMART_SWITCH_REV1_CPUAPP_NS

config HAS_BT_CTLR
	bool
	default BT

config BUILD_WITH_TFM
	default y

endif # BOARD_SMART_SWITCH_REV1_CPUAPP_NS
```

## boards/smart_switch_rev2/Kconfig.smart_switch_rev2
```kconfig
# Copyright (c) 2024 Nordic Semiconductor ASA
# SPDX-License-Identifier: Apache-2.0

config BOARD_SMART_SWITCH_REV2
	select SOC_NRF54L15_CPUAPP if BOARD_SMART_SWITCH_REV2_NRF54L15_CPUAPP || BOARD_SMART_SWITCH_REV2_NRF54L15_CPUAPP_NS
```

## boards/smart_switch_rev2/board.yml
```yaml
board:
  name: smart_switch_rev2
  full_name: Smart Switch Rev2
  vendor: nordic
  socs:
    - name: nrf54l15
      variants:
        - name: ns
          cpucluster: cpuapp
runners:
  run_once:
    '--recover':
      - runners:
          - nrfjprog
          - nrfutil
        run: first
        groups:
          - boards:
              - smart_switch_rev2/nrf54l15/cpuapp
              - smart_switch_rev2/nrf54l15/cpuapp/ns
    '--erase':
      - runners:
          - nrfjprog
          - jlink
          - nrfutil
        run: first
        groups:
          - boards:
              - smart_switch_rev2/nrf54l15/cpuapp
              - smart_switch_rev2/nrf54l15/cpuapp/ns
    '--reset':
      - runners:
          - nrfjprog
          - jlink
          - nrfutil
        run: last
        groups:
          - boards:
              - smart_switch_rev2/nrf54l15/cpuapp
              - smart_switch_rev2/nrf54l15/cpuapp/ns
```

## protocol/matter/Kconfig.sysbuild
```kconfig
#
# Copyright (c) 2023 Nordic Semiconductor ASA
#
# SPDX-License-Identifier: LicenseRef-Nordic-5-Clause
#

#### Radio core selection
config NRF_DEFAULT_IPC_RADIO
	default y

#### Bootloader
choice BOOTLOADER
	default BOOTLOADER_MCUBOOT if USE_BOOTLOADER
endchoice

if BOOTLOADER_MCUBOOT

#### DFU multi-image support
config DFU_MULTI_IMAGE_PACKAGE_BUILD
	default y

config DFU_MULTI_IMAGE_PACKAGE_APP
	default y

config PM_EXTERNAL_FLASH_MCUBOOT_SECONDARY
	default y

endif # BOOTLOADER_MCUBOOT

#### Enable generating factory data
config MATTER_FACTORY_DATA_GENERATE
	default y

source "share/sysbuild/Kconfig"
```
